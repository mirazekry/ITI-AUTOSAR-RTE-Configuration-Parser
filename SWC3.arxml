AUTOSAR XML (schema 4-3-0)
package /Mira_Project
  service sw component type SWC3
    provide port Han3mel_Peripheral_men_el7adeda: nonqueued-sender-com-spec=Mark_Zft1, provided-interface=Interface_Mark_Zft
    behavior SWC3_InternalBehavior
  swc implementation SWC3_Implementation: behavior=SWC3_InternalBehavior
