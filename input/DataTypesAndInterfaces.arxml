AUTOSAR XML (schema 4-3-0)
package /SeatHeater/DataTypes
  app type Boolean
  app type UnsignedInteger_8
  app type UnsignedInteger_32
package /SeatHeater/PortInterfaces
  10 x sender receiver interface:
    RightSeatHeaterIOInterface
      data RightHeaterValue: type=UnsignedInteger_32
    LeftSeatHeaterIOInterface
      data LeftHeaterValue: type=UnsignedInteger_32
    RegulatorIOInterface
      data RegulatorValue: type=UnsignedInteger_32
    RightSensorIOInterface
      data RightSensorValue: type=Boolean
    LeftSensorIOInterface
      data LeftSensorValue: type=Boolean
    RightSeatStatusInterface
      data PassengerOnRightSeat: type=Boolean
    LeftSeatStatusInterface
      data PassengerOnLeftSeat: type=Boolean
    RegulatorPosition
      data Position: type=UnsignedInteger_32
    LeftLevelInterface
      data Left_Level_Heater: type=UnsignedInteger_8
    RightLevelInterface
      data Right_Level_Interface: type=UnsignedInteger_8
