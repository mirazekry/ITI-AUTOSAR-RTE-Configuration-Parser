AUTOSAR XML (schema 4-3-0)
package /Mira_Project
  application sw component type SWC1
    require port Ta5el ya Mido: nonqueued-receiver-com-spec=Mark_Zft1, required-interface=Interface_Mark_Zft
    behavior SWC1_InternalBehavior
  swc implementation SWC1_Implementation: behavior=SWC1_InternalBehavior
