AUTOSAR XML (schema 4-3-0)
package /Mira_Project
  complex device driver sw component type SWC2
    provide port Salamo_3alekom_azykom_ya_shabab: nonqueued-sender-com-spec=Mark_Zft1, provided-interface=Interface_Mark_Zft
    behavior SWC2_InternalBehavior
  swc implementation SWC2_Implementation: behavior=SWC2_InternalBehavior
