AUTOSAR XML (schema 4-3-0)
standard types defined: boolean, uint8, sint8, uint16, sint16, uint32, sint32, float32
package /Mira_Project
  ar-package:
    impl type Mira_Struct1: category=STRUCTURE
      element Struct1_Data1: category=Value, implementation-data-type=Mira_Value1
      element Struct1_Data2: category=Array, implementation-data-type=Mira_Arr1
      element Struct1_Data3: category=Value, base-type=boolean
    impl type Struct2: category=STRUCTURE
      element dd1: category=Value, implementation-data-type=Mira_Value1
package /Mira_Project/ImplementationDataTypes
  impl type Mira_Value1: category=VALUE, base-type=boolean
  impl type Mira_Value2: category=VALUE, implementation-data-type=Mira_Arr1
  impl type Mira_Value3: category=VALUE, implementation-data-type=Mira_Struct1
package /Mira_Project/ImplementationDataTypes
  impl type Mira_Arr1: category=ARRAY
    element Element: category=Value, array-size=10, array-size-semantics=FIXED-SIZE, base-type=uint8
  impl type Mira_Arr2: category=ARRAY
    element Element: category=Struct, array-size=8, array-size-semantics=FIXED-SIZE, implementation-data-type=Mira_Struct1
package /Mira_Project/PortInterfaces
  sender receiver interface Interface_Mark_Zft
    data Mark_Zft1: type=Mira_Arr1
  sender receiver interface Sender_Receiver
    data SR_DataElement: type=Struct_1
  client server interface InterfaceCS
    operation Operation1
      arg Argument1: type=Mira_Struct1, direction=input
  client server interface Client_Server
    operation CS_Operation
      arg arg1: type=Struct_1, direction=output
      arg arg2: type=Value_One, direction=input
