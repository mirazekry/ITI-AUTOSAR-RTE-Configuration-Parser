AUTOSAR XML (schema 4-3-0)
standard types defined: boolean, uint8, sint8, uint16, sint16, uint32, sint32, float32
package /For_Mira
  ar-package:
    impl type Struct_1: category=STRUCTURE
      element Boolean_Element: category=Value, base-type=boolean
      element Array_Element: category=Array, implementation-data-type=Array_One
      element Value_Element: category=Value, implementation-data-type=Value_One
package /For_Mira/ImplementationDataTypes
  impl type Value_One: category=VALUE, base-type=boolean
package /For_Mira/ImplementationDataTypes
  impl type Array_One: category=ARRAY
    element Element: category=Value, array-size=10, array-size-semantics=FIXED-SIZE, base-type=boolean
  impl type Array_Two: category=ARRAY
    element Element: category=Value, array-size=10, array-size-semantics=FIXED-SIZE, implementation-data-type=Value_One
package /For_Mira/PortInterfaces
  sender receiver interface Sender_Receiver
    data SR_DataElement: type=Struct_1
  client server interface Client_Server
    operation CS_Operation
      arg arg1: type=Struct_1, direction=output
      arg arg2: type=Value_One, direction=input
